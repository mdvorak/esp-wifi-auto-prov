## Kconfig
```kconfig
menu "Wi-Fi Auto Provisioning"
    choice WIFI_AUTO_PROV_MODE
        prompt "WiFi provisioning mode"
        default WIFI_AUTO_PROV_TYPE_BLE

        config WIFI_AUTO_PROV_TYPE_BLE
            bool "Bluetooth"
        config WIFI_AUTO_PROV_TYPE_SOFT_AP
            bool "WiFi SoftAP"
    endchoice

    config WIFI_AUTO_PROV_TIMEOUT_S
        int "Wi-Fi provisioning timeout"
        default 120
        help
            Timeout, after which is Wi-Fi provisioning stopped and device
            continues in normal mode of operation (connected or not).

    config WIFI_AUTO_PROV_TRANSPORT
        string
        default "ble" if WIFI_AUTO_PROV_TYPE_BLE
        default "softap" if WIFI_AUTO_PROV_TYPE_SOFT_AP

    config WIFI_AUTO_PROV_QRCODE_URL
        string "QR Code URL"
        default "https://espressif.github.io/esp-jumpstart/qrcode.html"
        help
            QR code data are passed as JSON in data URL parameter.

    config WIFI_AUTO_PROV_SERVICE_PREFIX
        string "Prefix for service name"
        default "PROV_"
        help
            Service name is displayed during provisioning as a device name.
            This value is ignored when service_name is set manually during config.

    choice WIFI_AUTO_PROV_SCHEME_EVENT_HANDLER
        prompt "Provisioning scheme event handler"
        default WIFI_AUTO_PROV_SCHEME_EVENT_HANDLER_FREE_BTDM if WIFI_AUTO_PROV_TYPE_BLE
        default WIFI_AUTO_PROV_SCHEME_EVENT_HANDLER_NONE if !WIFI_AUTO_PROV_TYPE_BLE

        config WIFI_AUTO_PROV_SCHEME_EVENT_HANDLER_NONE
            bool "WIFI_PROV_EVENT_HANDLER_NONE"
        config WIFI_AUTO_PROV_SCHEME_EVENT_HANDLER_FREE_BTDM
            bool "WIFI_PROV_SCHEME_BLE_EVENT_HANDLER_FREE_BTDM"
        config WIFI_AUTO_PROV_SCHEME_EVENT_HANDLER_FREE_BLE
            bool "WIFI_AUTO_PROV_SCHEME_EVENT_HANDLER_FREE_BLE"
        config WIFI_PROV_SCHEME_BLE_EVENT_HANDLER_FREE_BT
            bool "WIFI_PROV_SCHEME_BLE_EVENT_HANDLER_FREE_BT"

        help
            By default, BLE resources are released after provisioning is complete.
            If you need BLE to be used by the app, set this to other value.
            To disable, set it to WIFI_PROV_EVENT_HANDLER_NONE.
    endchoice
endmenu
```

## example/sdkconfig.defaults
```kconfig
# WiFi provisioning
CONFIG_APP_WIFI_PROV_TYPE_BLE=y
CONFIG_APP_WIFI_PROV_TYPE_SOFT_AP=n

# BLE for provisioning
CONFIG_BT_ENABLED=y
CONFIG_BTDM_CTRL_MODE_BLE_ONLY=y
CONFIG_BTDM_CTRL_MODE_BR_EDR_ONLY=n
CONFIG_BTDM_CTRL_MODE_BTDM=n
CONFIG_BT_NIMBLE_ENABLED=y
```
